; PROGRAMA QUE LEE UN TEXTO DE MEMORIA
; Y LO DESPLIEGA EN LA PANATALLA
;PROGRAMA PRINCIPAL
	.ORG	0000H	;CODIGO
	LD SP,27FFH	;INICIA STACX
	LD HL,TEXTO1
	CALL DESP_TEXTO
	CALL LEE_CLAVE
	CALL COMPARA
;	LD HL,TEXTO2
;	CALL DESP_TEXTO
	HALT

	.ORG	2000H ;DATOS
TEXTO1 .DB	"NIP: &"
TEXTO2 .DB	"CLAVE OK :) &"
TEXTO3 .DB	"CLAVE NOK :( &"
CLAVE  .DB 	"9637"
INCLA	.DB	00h,00h,00h,00h
FLAG	.DB	00h
LCD	.EQU	00H
KEYB	.EQU	01H

;SUBRUTINAS
DESP_TEXTO:
	LD A,(HL)
	CP '&'
	JP Z,FIN
	OUT (LCD),A
	INC HL
	JP DESP_TEXTO
FIN:
	RET

LEE_CLAVE:
	LD HL,INCLA
	LD B,4
CICLO2:
	IN A,(KEYB)
	LD (HL),A
	CP 0DH
	JP Z,FIN2
	INC HL
	DJNZ CICLO2
FIN2:
	RET

COMPARA:
	LD B,4
	LD C,0		;bandera
	LD IX,INCLA
	LD HL,CLAVE
CICLO3:
	LD A,(IX+0)
	CP (HL)
	JR Z,OTRA
	INC C
	DEC B
	JR NZ,CICLO3
	LD HL,TEXTO3
	CALL DESP_TEXTO
	JP FIN3

OTRA:
	INC IX
	INC HL
	DEC B
	JR NZ,CICLO3
	LD HL,TEXTO2
	CALL DESP_TEXTO
FIN3:
	RET

	.END